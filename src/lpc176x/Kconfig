## src/lpc176x/Kconfig
```kconfig
# Kconfig settings for LPC176x processors

if MACH_LPC176X

config LPC_SELECT
    bool
    default y
    select HAVE_GPIO
    select HAVE_GPIO_ADC
    select HAVE_GPIO_I2C
    select HAVE_GPIO_SPI
    select HAVE_GPIO_BITBANGING
    select HAVE_STRICT_TIMING
    select HAVE_CHIPID
    select HAVE_GPIO_HARD_PWM

config BOARD_DIRECTORY
    string
    default "lpc176x"

choice
    prompt "Processor model"
    config MACH_LPC1768
        bool "lpc1768 (100 MHz)"
    config MACH_LPC1769
        bool "lpc1769 (120 MHz)"
endchoice

config MCU
    string
    default "lpc1768" if MACH_LPC1768
    default "lpc1769" if MACH_LPC1769

config CLOCK_FREQ
    int
    default 100000000 if MACH_LPC1768
    default 120000000 if MACH_LPC1769

config FLASH_SIZE
    hex
    default 0x80000

config RAM_START
    hex
    default 0x10000000

config RAM_SIZE
    hex
    default 0x7fe0 # (0x8000 - 32) - top 32 bytes used by IAP functions

config STACK_SIZE
    int
    default 512

config SMOOTHIEWARE_BOOTLOADER
    bool "Target board uses Smoothieware bootloader"
    default y

config FLASH_START
    hex
    default 0x4000 if SMOOTHIEWARE_BOOTLOADER
    default 0x0000

config USBSERIAL
    bool
config SERIAL
    bool
choice
    config LPC_USB
        bool "USB"
        select USBSERIAL
	config LPC_SERIAL_UART0
        bool "Serial (on UART0 P0.3/P0.2)"
        select SERIAL
    config LPC_SERIAL_UART1
        bool "Serial (on UART1 P0.16/P0.15)" 
        select SERIAL
    config LPC_SERIAL_UART2
        bool "Serial (on UART2 P0.11/P0.10)"
        select SERIAL
    config LPC_SERIAL_UART3
        bool "Serial (on UART3 P4.29/P4.28)"
        select SERIAL	
endchoice

endif
```
